#include <WiFi.h>
#include <HTTPClient.h>

#include <Wire.h>
#include <Adafruit_GFX.h>
#include <Adafruit_SSD1306.h>
#include "DHT.h"

#define DHTPIN 23  // Pin connected to the DHT11 data pin
#define DHTTYPE DHT11
#define SOIL_MOISTURE_PIN 34  // Analog pin for soil moisture sensor
#define SCREEN_WIDTH 128  // OLED display width, in pixels
#define SCREEN_HEIGHT 64  // OLED display height, in pixels

#define WIFI_LED_PIN 25
#define DATA_LED_PIN 26
#define WIFI_DIS_LED_PIN 27

#define DRY_SOIL_LED_PIN 33
#define WET_SOIL_LED_PIN 32
#define HIGH_WATER_LED_PIN 35

// Create SSD1306 display object
Adafruit_SSD1306 oled(SCREEN_WIDTH, SCREEN_HEIGHT, &Wire, -1);
DHT dht(DHTPIN, DHTTYPE);

unsigned long previousMillis = 0;
unsigned long previousPrintMillis = 0;
unsigned long previousBuzzerMillis = 0;
const long interval = 30000;    // 30 seconds for backend updates
const long printInterval = 5000; // 5 seconds for Serial Monitor updates
const long buzzerInterval = 5000; // 5 seconds for buzzer checks


// 'Company Logo', 128x64px
const unsigned char epd_bitmap_monochrome [] PROGMEM = {
  0x00, 0x00, 0x00, 0x00, 0x00, 0x00, 0x00, 0x00, 0x00, 0x00, 0x00, 0x00, 0x00, 0x00, 0x00, 0x00,
  0x00, 0x00, 0x00, 0x00, 0x00, 0x00, 0x00, 0x00, 0x1c, 0x30, 0x00, 0x00, 0x00, 0x00, 0x00, 0x00,
  0x00, 0x00, 0x00, 0x00, 0x00, 0x00, 0x00, 0x00, 0x0c, 0x30, 0x00, 0x00, 0x00, 0x00, 0x00, 0x00,
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  0x00, 0x00, 0x00, 0x00, 0x00, 0x00, 0x11, 0x80, 0x00, 0x00, 0x00, 0x00, 0x00, 0x00, 0x00, 0x00
};

// 'Wi-Fi-Logo', 128x64px
const unsigned char epd_bitmap_Wi_Fi_Logo [] PROGMEM = {
  0x00, 0x00, 0x00, 0x00, 0x00, 0x00, 0x00, 0x00, 0x00, 0x00, 0x00, 0x00, 0x00, 0x00, 0x00, 0x00,
  0x00, 0x00, 0x00, 0x00, 0x00, 0x00, 0x00, 0x00, 0x00, 0x00, 0x00, 0x00, 0x00, 0x00, 0x00, 0x00,
  0x00, 0x00, 0x00, 0x00, 0x00, 0x00, 0x00, 0x00, 0x00, 0x00, 0x00, 0x00, 0x00, 0x00, 0x00, 0x00,
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  0x00, 0x00, 0x00, 0x00, 0x00, 0x00, 0x00, 0x00, 0x00, 0x00, 0x00, 0x00, 0x00, 0x00, 0x00, 0x00
};

// 'connecting Wi-Fi-Logo', 128x64px
const unsigned char epd_bitmap_connecting_Wi_Fi_Logo [] PROGMEM = {
  0x00, 0x00, 0x00, 0x00, 0x00, 0x00, 0x00, 0x00, 0x00, 0x00, 0x00, 0x00, 0x00, 0x00, 0x00, 0x00,
  0x00, 0x00, 0x00, 0x00, 0x00, 0x00, 0x00, 0x00, 0x00, 0x00, 0x00, 0x00, 0x00, 0x00, 0x00, 0x00,
  0x00, 0x00, 0x00, 0x00, 0x00, 0x00, 0x00, 0x00, 0x00, 0x00, 0x00, 0x00, 0x00, 0x00, 0x00, 0x00,
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  0x00, 0x00, 0x00, 0x00, 0x00, 0x00, 0x00, 0x00, 0x00, 0x00, 0x00, 0x00, 0x00, 0x00, 0x00, 0x00
};

// 'Wi-Fi-disconnected logo', 128x64px
const unsigned char epd_bitmap_Wi_Fi_disconnected_logo [] PROGMEM = {
  0x00, 0x00, 0x00, 0x00, 0x00, 0x00, 0x00, 0x00, 0x00, 0x00, 0x00, 0x00, 0x00, 0x00, 0x00, 0x00,
  0x00, 0x00, 0x00, 0x00, 0x00, 0x00, 0x00, 0x00, 0x00, 0x00, 0x00, 0x00, 0x00, 0x00, 0x00, 0x00,
  0x00, 0x00, 0x00, 0x00, 0x00, 0x00, 0x00, 0x00, 0x00, 0x00, 0x03, 0x80, 0x00, 0x00, 0x00, 0x00,
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  0x00, 0x00, 0x00, 0x00, 0x00, 0x00, 0x00, 0x00, 0x00, 0x00, 0x00, 0x00, 0x00, 0x00, 0x00, 0x00
};

// 'Agrolink', 128x64px
const unsigned char epd_bitmap_Agrolink [] PROGMEM = {
  0x00, 0x00, 0x00, 0x00, 0x00, 0x00, 0x00, 0x00, 0x00, 0x00, 0x00, 0x00, 0x00, 0x00, 0x00, 0x00,
  0x00, 0x00, 0x00, 0x00, 0x00, 0x00, 0x00, 0x00, 0x00, 0x00, 0x00, 0x00, 0x00, 0x00, 0x00, 0x00,
  0x00, 0x00, 0x00, 0x00, 0x00, 0x00, 0x00, 0x00, 0x00, 0x00, 0x00, 0x00, 0x00, 0x00, 0x00, 0x00,
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  0x00, 0x00, 0x00, 0x00, 0x00, 0x00, 0x00, 0x00, 0x00, 0x00, 0x00, 0x00, 0x00, 0x00, 0x00, 0x00
};

// 'mechanic', 128x64px
const unsigned char epd_bitmap_mechanic [] PROGMEM = {
  0x00, 0x00, 0x00, 0x00, 0x00, 0x00, 0x00, 0x00, 0x00, 0x00, 0x00, 0x00, 0x00, 0x00, 0x00, 0x00,
  0x00, 0x00, 0x00, 0x00, 0x00, 0x00, 0x00, 0x00, 0x00, 0x00, 0x00, 0x00, 0x00, 0x00, 0x00, 0x00,
  0x00, 0x00, 0x00, 0x00, 0x00, 0x00, 0x00, 0x00, 0x00, 0x00, 0x00, 0x00, 0x00, 0x00, 0x00, 0x00,
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  0x00, 0x00, 0x00, 0x00, 0x00, 0x00, 0x00, 0x00, 0x00, 0x00, 0x00, 0x00, 0x00, 0x00, 0x00, 0x00
};

// 'innovated', 128x64px
const unsigned char epd_bitmap_innovated [] PROGMEM = {
  0x00, 0x00, 0x00, 0x00, 0x00, 0x00, 0x00, 0x00, 0x00, 0x00, 0x00, 0x00, 0x00, 0x00, 0x00, 0x00,
  0x00, 0x00, 0x00, 0x00, 0x00, 0x00, 0x00, 0x00, 0x00, 0x00, 0x00, 0x00, 0x00, 0x00, 0x00, 0x00,
  0x00, 0x00, 0x00, 0x00, 0x00, 0x00, 0x00, 0x00, 0x00, 0x00, 0x00, 0x00, 0x00, 0x00, 0x00, 0x00,
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  0x00, 0x00, 0x00, 0x00, 0x00, 0x00, 0x00, 0x00, 0x00, 0x00, 0x00, 0x00, 0x00, 0x00, 0x00, 0x00
};

// Wi-Fi credentials
//const char* ssid = "Dialog 4G 583"; // Replace with your Wi-Fi SSID
//const char* password = "f4359417"; // Replace with your Wi-Fi password

//const char* ssid = "SLT-4G-E54B";
//const char* password = "3N1400BRRJJ";

const char* ssid = "Chanaka_Fiber";
const char* password = "tharinduCHA@8754";

const char* serverUrl = "http://192.168.1.10:8080/PlantSystem/api/sensors/data";

void sendDataToBackend(float temperature, float humidity, int soilMoistureValue) {
  if (WiFi.status() == WL_CONNECTED) {
    HTTPClient http;
    http.begin(serverUrl);
    http.addHeader("Content-Type", "application/json");

    // Prepare JSON payload
    String payload = "{";
    payload += "\"temperature\": " + String(temperature, 2) + ",";
    payload += "\"humidity\": " + String(humidity, 2) + ",";
    payload += "\"soil_moisture\": " + String(soilMoistureValue);
    payload += "}";

    Serial.println("Sending payload:");
    Serial.println(payload);

    int httpResponseCode = http.POST(payload);

    Serial.print("HTTP Response Code: ");
    Serial.println(httpResponseCode);

    if (httpResponseCode > 0) {
      String response = http.getString();
      Serial.println("Response from server: " + response);
    } else {
      Serial.println("Error sending data to server: " + String(httpResponseCode));
      Serial.println(http.errorToString(httpResponseCode).c_str());
    }
    http.end();
  } else {
    Serial.println("WiFi disconnected!");
    digitalWrite(WIFI_DIS_LED_PIN, HIGH);
    digitalWrite(WIFI_LED_PIN, LOW);
    digitalWrite(DATA_LED_PIN, LOW);
  }
}

void setup() {
  // Initialize Serial Monitor
  Serial.begin(115200);

  // Initialize OLED display
  if (!oled.begin(SSD1306_SWITCHCAPVCC, 0x3C)) {
    Serial.println("OLED initialization failed!");
    while (true)
      ;  // Halt program if OLED initialization fails
  }

  oled.clearDisplay();
  oled.setTextSize(1);
  oled.setTextColor(WHITE);

  // Welcome message on OLED
  oled.setCursor(0, 0);
  oled.println("Initializing...");
  oled.display();
  delay(2000);
  oled.clearDisplay();

  // Initialize DHT sensor
  dht.begin();
  pinMode(WIFI_LED_PIN, OUTPUT);
  pinMode(DATA_LED_PIN, OUTPUT);
  pinMode(WIFI_DIS_LED_PIN, OUTPUT);

  pinMode(DRY_SOIL_LED_PIN, OUTPUT);
  pinMode(WET_SOIL_LED_PIN, OUTPUT);
  pinMode(HIGH_WATER_LED_PIN, OUTPUT);

  // Display the logo
  oled.drawBitmap(0, 0, epd_bitmap_monochrome, 128, 64, WHITE);  // Company Logo bitmap
  oled.display();
  delay(5000);
  oled.clearDisplay();

  oled.drawBitmap(0, 0, epd_bitmap_Agrolink, 128, 64, WHITE);
  oled.display();
  delay(4000);
  oled.clearDisplay();

  oled.drawBitmap(0, 0, epd_bitmap_innovated, 128, 64, WHITE);
  oled.display();
  delay(7000);
  oled.clearDisplay();

  oled.drawBitmap(0, 0, epd_bitmap_mechanic, 128, 64, WHITE);
  oled.display();
  delay(7000);
  oled.clearDisplay();

  // Set ESP32 to Station Mode
  WiFi.mode(WIFI_STA); // Set mode to Station (client)

  // Connect to Wi-Fi
  WiFi.begin(ssid, password);
  while (WiFi.status() != WL_CONNECTED) {
    delay(1000);
    Serial.println("Connecting to WiFi...");

    // Display the logo
    oled.drawBitmap(0, 0, epd_bitmap_connecting_Wi_Fi_Logo, 128, 64, WHITE);  // Logo bitmap
    oled.display();
    delay(6000);
    oled.clearDisplay();

    for (int i = 0; i < 10; i++) {  // Loop to blink the LED 10 times
      digitalWrite(WIFI_LED_PIN, HIGH);  // Turn the LED on
      digitalWrite(WIFI_DIS_LED_PIN, LOW);
      delay(100);// Wait for 500 milliseconds
      digitalWrite(WIFI_LED_PIN, LOW);// Turn the LED off
      digitalWrite(WIFI_DIS_LED_PIN, LOW);
      delay(100); // Wait for 500 milliseconds

    }
  }
  Serial.println("Connected to WiFi");
  // Display the logo
  oled.drawBitmap(0, 0, epd_bitmap_Wi_Fi_Logo, 128, 64, WHITE);  // Logo bitmap
  oled.display();
  delay(6000);
  oled.clearDisplay();
}

void loop() {
  // Read temperature and humidity from DHT11
  float temperature = dht.readTemperature();
  float humidity = dht.readHumidity();

  // Read soil moisture value
  int rawSoilMoistureValue = analogRead(SOIL_MOISTURE_PIN);
  int soilMoistureValue = map(rawSoilMoistureValue, 0, 4095, 0, 1000);

  // Check if DHT sensor failed to read
  if (isnan(temperature) || isnan(humidity)) {
    Serial.println("Failed to read from DHT sensor!");
    oled.clearDisplay();
    oled.setCursor(0, 0);
    oled.println("DHT Error!");
    oled.display();
    delay(2000);
    return;
  }

  // Debugging: Print values to Serial Monitor
  unsigned long currentMillis = millis();
  if (currentMillis - previousPrintMillis >= printInterval) {
    previousPrintMillis = currentMillis;
    // Display values on OLED
    oled.clearDisplay();
    oled.setCursor(0, 10);
    oled.printf("Temperature: %.2f C\n", temperature);
    oled.setCursor(0, 25);
    oled.printf("Humidity: %.2f %%\n", humidity);
    oled.setCursor(0, 40);
    oled.printf("Soil Moisture: %d\n", soilMoistureValue);
    oled.setCursor(0, 55);

    // Soil moisture threshold calibration
    //    int moistureThreshold = 600;  // Adjust based on your calibration
    if (soilMoistureValue < 900) {
      oled.println("Soil is Humid");
      digitalWrite(WET_SOIL_LED_PIN, HIGH);
      digitalWrite(DRY_SOIL_LED_PIN, LOW);
      digitalWrite(HIGH_WATER_LED_PIN, LOW);
    } else if (soilMoistureValue < 600) {
      oled.println("Sensor in the water");
      digitalWrite(HIGH_WATER_LED_PIN, HIGH);
      digitalWrite(WET_SOIL_LED_PIN, LOW);
      digitalWrite(DRY_SOIL_LED_PIN, LOW);
    } else {
      oled.println("Soil is Dry");
      digitalWrite(DRY_SOIL_LED_PIN, HIGH);
      digitalWrite(WET_SOIL_LED_PIN, LOW);
      digitalWrite(HIGH_WATER_LED_PIN, LOW);
    }
    oled.display();  // Update OLED display
  }

  // WiFi LED logic
  if (WiFi.status() == WL_CONNECTED) {
    digitalWrite(WIFI_LED_PIN, HIGH); // Turn on WiFi LED when connected
  } else {
    digitalWrite(WIFI_LED_PIN, LOW); // Turn off WiFi LED when disconnected
  }

  // WiFi Disconnect LED logic
  if (WiFi.status() != WL_CONNECTED) {
    oled.drawBitmap(0, 0, epd_bitmap_Wi_Fi_disconnected_logo, 128, 64, WHITE);
    oled.display();
    delay(3000);
    oled.clearDisplay();
    digitalWrite(WIFI_DIS_LED_PIN, HIGH); // Turn on WiFi LED when connected
    digitalWrite(WIFI_LED_PIN, LOW);
  } else {
    digitalWrite(WIFI_DIS_LED_PIN, LOW);
    digitalWrite(WIFI_LED_PIN, HIGH); // Turn off WiFi LED when disconnected
  }

  // Handle backend data transmission every 30 seconds
  if (currentMillis - previousMillis >= interval) {
    previousMillis = currentMillis;
    sendDataToBackend(temperature, humidity, soilMoistureValue);
    for (int i = 0; i < 5; i++) {  // Loop to blink the LED 10 times
      digitalWrite(DATA_LED_PIN, HIGH);  // Turn the LED on
      delay(200);// Wait for 500 milliseconds
      digitalWrite(DATA_LED_PIN, LOW);// Turn the LED off
      delay(200); // Wait for 500 milliseconds
    }
  }
}



